## boards/others/promicro_nrf52840/Kconfig.promicro_nrf52840
```kconfig
# Copyright (c) 2026 The ZMK Contributors
# SPDX-License-Identifier: MIT

config BOARD_PROMICRO_NRF52840
    select ZMK_BOARD_COMPAT if BOARD_PROMICRO_NRF52840_NRF52840_UF2_ZMK
    imply RETAINED_MEM if BOARD_PROMICRO_NRF52840_NRF52840_UF2_ZMK
    imply RETENTION if BOARD_PROMICRO_NRF52840_NRF52840_UF2_ZMK
    imply RETENTION_BOOT_MODE if BOARD_PROMICRO_NRF52840_NRF52840_UF2_ZMK
```

## boards/others/promicro_nrf52840/board.yml
```yaml
board:
  extend: promicro_nrf52840
  variants:
    - name: zmk
      qualifier: nrf52840/uf2
```

## boards/others/promicro_nrf52840/promicro_nrf52840_nrf52840_uf2_zmk_defconfig
```kconfig
# SPDX-License-Identifier: MIT

# Enable MPU
CONFIG_ARM_MPU=y

# Use pinctrl
CONFIG_PINCTRL=y

# Enable GPIO
CONFIG_GPIO=y

# Code partition/output for UF2 bootloader builds
CONFIG_USE_DT_CODE_PARTITION=y
CONFIG_BUILD_OUTPUT_UF2=y

# Settings support
CONFIG_MPU_ALLOW_FLASH_WRITE=y
CONFIG_NVS=y
CONFIG_SETTINGS_NVS=y
CONFIG_FLASH=y
CONFIG_FLASH_PAGE_LAYOUT=y
CONFIG_FLASH_MAP=y

# ZMK transports
CONFIG_ZMK_BLE=y
CONFIG_ZMK_USB=y
```
